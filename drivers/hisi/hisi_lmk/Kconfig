## drivers/hisi/hisi_lmk/Kconfig
```kconfig
menu "Hisi lowmem killer"

config HISI_LOWMEM
	bool "Hisilicon Low Memory Killer"
	default n
	depends on ANDROID_SIMPLE_LMK
	help
	  Enables hisi lowmem killer parameter tuning

config HISI_LOWMEM_DBG
	bool "Hisilicon Low Memory Killer debug"
	default n
	depends on ANDROID_SIMPLE_LMK
	help
	  print processes info when lmk happen per several seconds

config HISI_MULTI_KILL
	bool "Enable lmk multi kill"
	default n
	depends on ANDROID_SIMPLE_LMK
	help
	  When enabled, lmk will kill multi thread at once.

endmenu
```
